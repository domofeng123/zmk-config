## config/west.yml
```yaml
manifest:
  remotes:
    - name: domofeng123
      url-base: https://github.com/domofeng123
  projects:
    - name: zmk
      remote: domofeng123
      revision: split
      import: app/west.yml
  self:
    path: config
```
